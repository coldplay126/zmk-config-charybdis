## config/west.yml
```yaml
manifest:
  remotes:
    - name: zmkfirmware
      url-base: https://github.com/coldplay126
  projects:
    - name: zmk
      remote: zmkfirmware
      revision: pmw3610-aml
      import: app/west.yml
  self:
    path: config
```
